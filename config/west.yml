## config/west.yml
```yaml
manifest:
  remotes:
    - name: zmkfirmware
      url-base: https://github.com/zmkfirmware
  projects:
    - name: zmk
      remote: zmkfirmware
      revision: eeb8a0077851cbe3394f6ef49cf5527cd3a5020e
      import: app/west.yml
  self:
    path: config
```
