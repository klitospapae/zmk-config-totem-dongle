/*
 * Copyright (c) 2026 The ZMK Contributors
 *
 * SPDX-License-Identifier: MIT
 */

&kscan0 {
    row-gpios
        = <&pro_micro_a 0 (GPIO_ACTIVE_HIGH | GPIO_PULL_DOWN)>
        , <&pro_micro_a 1 (GPIO_ACTIVE_HIGH | GPIO_PULL_DOWN)>
        , <&pro_micro_a 2 (GPIO_ACTIVE_HIGH | GPIO_PULL_DOWN)>
        , <&pro_micro_a 3 (GPIO_ACTIVE_HIGH | GPIO_PULL_DOWN)>
        ;

    col-gpios
        = <&pro_micro_a 6 GPIO_ACTIVE_HIGH>
        , <&pro_micro_a 7 GPIO_ACTIVE_HIGH>
        , <&pro_micro_a 10 GPIO_ACTIVE_HIGH>
        , <&pro_micro_a 9 GPIO_ACTIVE_HIGH>
        , <&pro_micro_a 8 GPIO_ACTIVE_HIGH>
        ;
};
